## block/Kconfig.iosched
```kconfig
# SPDX-License-Identifier: GPL-2.0
if BLOCK

menu "IO Schedulers"

config IOSCHED_NOOP
    bool
    default y
    ---help---
      The no-op I/O scheduler is a minimal scheduler that does basic merging
      and sorting.

config IOSCHED_DEADLINE
    tristate "Deadline I/O scheduler"
    default y

config IOSCHED_CFQ
    tristate "CFQ I/O scheduler"
    default y

config CFQ_GROUP_IOSCHED
    bool "CFQ Group Scheduling support"
    depends on IOSCHED_CFQ && BLK_CGROUP
    default n

config MQ_IOSCHED_DEADLINE
    tristate "MQ deadline I/O scheduler"
    default y
    ---help---
      MQ version of the deadline IO scheduler.

config MQ_IOSCHED_KYBER
    tristate "Kyber I/O scheduler"
    default y

config IOSCHED_BFQ
    tristate "BFQ I/O scheduler"
    default y
    ---help---
      BFQ I/O scheduler for BLK-MQ. Recommended for UFS/NVMe.

config BFQ_GROUP_IOSCHED
       bool "BFQ hierarchical scheduling support"
       depends on IOSCHED_BFQ && BLK_CGROUP
       default n

choice
    prompt "Default I/O scheduler"
    default DEFAULT_BFQ
    help
      Select the I/O scheduler which will be used by default for all
      block devices.

    config DEFAULT_DEADLINE
        bool "Deadline" if IOSCHED_DEADLINE=y

    config DEFAULT_CFQ
        bool "CFQ" if IOSCHED_CFQ=y

    config DEFAULT_NOOP
        bool "No-op"

    config DEFAULT_MQ_DEADLINE
        bool "MQ Deadline" if MQ_IOSCHED_DEADLINE=y

    config DEFAULT_KYBER
        bool "Kyber" if MQ_IOSCHED_KYBER=y

    config DEFAULT_BFQ
        bool "BFQ" if IOSCHED_BFQ=y

endchoice

config DEFAULT_IOSCHED
    string
    default "deadline" if DEFAULT_DEADLINE
    default "cfq" if DEFAULT_CFQ
    default "noop" if DEFAULT_NOOP
    default "mq-deadline" if DEFAULT_MQ_DEADLINE
    default "kyber" if DEFAULT_KYBER
    default "bfq" if DEFAULT_BFQ

endmenu

endif
```
